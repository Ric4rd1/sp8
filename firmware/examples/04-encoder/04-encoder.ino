// Pin conections
const int A = 17; // Input signal A form encoder
const int B = 16; // Input signal B from encoder

volatile long n = 0; // counts for encoder

double R = 4480; // Resolution R = mH x s x r,
                  // mH = counts per motor rev (11),
                  // s = states generated by AB channels (4),
                  // r = gearBox reduction ratio (21.3)

// encoders aux variables
volatile byte ant  = 0; // previous encoder state
volatile byte act  = 0; // actual encoder state 


void setup() {
  Serial.begin(115200);
  pinMode(A, INPUT);
  pinMode(B, INPUT);
  attachInterrupt(digitalPinToInterrupt(A), encoder, CHANGE);
  attachInterrupt(digitalPinToInterrupt(B), encoder, CHANGE);

}

void encoder(void){
  ant=act;
  
  if(digitalRead(A)) bitSet(act,1); else bitClear(act,1);            
  if(digitalRead(B)) bitSet(act,0); else bitClear(act,0);
  
  
  
  if(ant == 2 && act ==0) n++;
  if(ant == 0 && act ==1) n++;
  if(ant == 3 && act ==2) n++;
  if(ant == 1 && act ==3) n++;
  
  if(ant == 1 && act ==0) n--;
  if(ant == 3 && act ==1) n--;
  if(ant == 0 && act ==2) n--;
  if(ant == 2 && act ==3) n--;   

}

void loop() {
  Serial.print("Count: "); Serial.println(n);

}
