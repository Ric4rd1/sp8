// ---------- Constants ----------

// Encoder pins
#define A 17 // Input signal A form encoder
#define B 16 // Input signal B from encoder

// PWM pins
#define PWM_PIN_IN1 33     // Driver In 1
#define PWM_PIN_IN2 32     // Driver In 2

// PWM configurations
#define PWM_FRQ 5000   // PWM frequency (Hz)
#define PWM_RES 8      // PWM resolution (bits)
#define PWM_CHNL0 0     // PWM channel for in 1
#define PWM_CHNL1 1     // PWM channel for in 2

const double R = 4480; // Resolution R = mH x s x r,
                  // mH = counts per motor rev (11),
                  // s = states generated by AB channels (4),
                  // r = gearBox reduction ratio (21.3)

const unsigned long sampleTime = 50; // Sample time in milliseconds
const float T = sampleTime/1000.0;

const float pi = 3.1416;

// Gains
const float kp = 25.0;
const float ki = 320.0;
const float kd = 0.8;

// ---------- Variables ----------
volatile long n = 0; // counts for encoder
volatile long nant = 0;
// encoders aux variables
volatile byte ant  = 0; // previous encoder state
volatile byte act  = 0; // actual encoder state

unsigned long prevTime = 0;

double vel;
unsigned int pwm = 0;
float K1,K2,K3;
float setpoint = 0.0; // velocity reference
float e[3] = {0.0,0.0,0.0}; // e[0] actual error, e[1] last error, e[2] error before last
float u[2] = {0.0,0.0}; // u[0] actual output, u[1] last output



void setup() {
  Serial.begin(115200);
  // Configure encoder
  pinMode(A, INPUT);
  pinMode(B, INPUT);
  attachInterrupt(digitalPinToInterrupt(A), encoder, CHANGE);
  attachInterrupt(digitalPinToInterrupt(B), encoder, CHANGE);

  // Configure PWM
  // Set pins as output
  pinMode(PWM_PIN_IN1, OUTPUT); 
  pinMode(PWM_PIN_IN2, OUTPUT);
  // Configure pwm channel
  ledcSetup(PWM_CHNL0, PWM_FRQ, PWM_RES); 
  ledcSetup(PWM_CHNL1, PWM_FRQ, PWM_RES);
  // Assign pins
  ledcAttachPin(PWM_PIN_IN1, PWM_CHNL0);
  ledcAttachPin(PWM_PIN_IN2, PWM_CHNL1);

  // Control constants (Incremental form)
  K1 = kp + T*ki + kd/T;
  K2 = -kp - 2.0*kd/T;
  K3 = kd/T;

}

void encoder(void){
  ant=act;
  
  if(digitalRead(A)) bitSet(act,1); else bitClear(act,1);            
  if(digitalRead(B)) bitSet(act,0); else bitClear(act,0);
  
  
  
  if(ant == 2 && act ==0) n++;
  if(ant == 0 && act ==1) n++;
  if(ant == 3 && act ==2) n++;
  if(ant == 1 && act ==3) n++;
  
  if(ant == 1 && act ==0) n--;
  if(ant == 3 && act ==1) n--;
  if(ant == 0 && act ==2) n--;
  if(ant == 2 && act ==3) n--;   

}

void loop() {
  unsigned long currentTime = millis();
  double dt = currentTime-prevTime;
  
  if(dt >= sampleTime){

    // Estimate Velocity
    dt = dt / 1e3; // Convert to seconds
    vel = (n - nant) / dt; // Counts per second
    vel = vel/R; // Revolutions per second
    vel = vel * (2.0 * pi); // Radians per second
    
    // Print estimation 
    /*
    Serial.print("Set: "); Serial.println(set);
    Serial.print("PWM: "); Serial.println(pwm);
    Serial.print("Count: "); Serial.println(n);
    Serial.print("Rev/s: "); Serial.println(vel);
    */
    Serial.println(vel);

    // Update values
    nant = n;
    prevTime = currentTime;

    // Calculate error
    e[0] = setpoint - vel;
    u[0] = K1*e[0]+K2*e[1]+K3*e[2]+u[1]; // discrete-time PID difference equation
    // Limit control signal
    if(u[0]>255) u[0] = 255;
    if(u[0]<-255) u[0] = -255;
    // Send control signal to motors
    if(u[0]>=0){
      ledcWrite(PWM_CHNL0, u[0]); //
      ledcWrite(PWM_CHNL1, 0); // set to 0
    } else{
      ledcWrite(PWM_CHNL1, -u[0]); //
      ledcWrite(PWM_CHNL0, 0); // set to 0
    }
    // Shift values
    e[2]=e[1];
    e[1]=e[0];
    u[1]=u[0];
  }

  if (Serial.available()>0) {
    setpoint = Serial.parseFloat();
    //setpoint = constrain(set, -1.0, 1);
    }

}

int floatMap(float x, float in_min, float in_max, float out_min, float out_max) {
  return (int)((x - in_min) * (out_max - out_min) / (in_max - in_min) + out_min);
}
