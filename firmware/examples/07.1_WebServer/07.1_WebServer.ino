#include <WiFi.h>       // standard library
#include <WebServer.h>  // standard library
// ---------- Constants ----------
// WebServer
//define USE_INTRANET // Comment to use an access point

// Using a local network
#define LOCAL_SSID "INFINITUM9DBD"
#define LOCAL_PASS "Aa1Sp5Kh7g"

// For Access point
#define AP_SSID "Spade"
#define AP_PASS "0123"

IPAddress Actual_IP;

IPAddress PageIP(192, 168, 1, 1);
IPAddress gateway(192, 168, 1, 1);
IPAddress subnet(255, 255, 255, 0);
IPAddress ip;
WebServer server(80); // Create server

// PWM configurations
#define PWM_FRQ 5000   // PWM frequency (Hz)
#define PWM_RES 8      // PWM resolution (bits)
#define PWM_CHNL0 0     // PWM channel for in 1
#define PWM_CHNL1 1     // PWM channel for in 2
#define PWM_CHNL2 2     // PWM channel for in 3
#define PWM_CHNL3 3     // PWM channel for in 4

// ### Left motor ###
// Encoder pins
#define lA 23 // Input signal A form encoder
#define lB 22 // Input signal B from encoder
// PWM pins
#define lPWM_PIN_IN1 27     // Driver In 1
#define lPWM_PIN_IN2 26     // Driver In 2

// ### Right motor ###
// Encoder pins
#define rA 17 // Input signal A form encoder
#define rB 16 // Input signal B from encoder
// PWM pins
#define rPWM_PIN_IN1 33     // Driver In 1
#define rPWM_PIN_IN2 32     // Driver In 2

const double R = 4480; // Resolution R = mH x s x r,
                  // mH = counts per motor rev (11),
                  // s = states generated by AB channels (4),
                  // r = gearBox reduction ratio (21.3)

const unsigned long sampleTime = 50; // Sample time in milliseconds
const float T = sampleTime/1000.0;

const float pi = 3.1416;
const float r = 0.0505; // radius of the wheel (m)
const float l = 0.19; // distance between wheels (m)

// Gains
const float kp = 25.0;
const float ki = 320.0;
const float kd = 0.8;

// ---------- Variables ----------
// Webserver slider values
float linearSpeed = 0.0; 
float angularSpeed = 0.0;

// PID
float K1,K2,K3;
unsigned long prevTime = 0;
float linear = 0.0;
float angular = 0.0;

// ### Left motor ###
volatile long ln = 0; // counts for encoder
volatile long lnant = 0;
// encoders aux variables
volatile byte lant  = 0; // previous encoder state
volatile byte lact  = 0; // actual encoder state
// PID
float lAngVel;
unsigned int lpwm = 0;
float lsetpoint = 0.0; // velocity reference
float le[3] = {0.0,0.0,0.0}; // e[0] actual error, e[1] last error, e[2] error before last
float lu[2] = {0.0,0.0}; // u[0] actual output, u[1] last output

// ### Right motor ###
volatile long rn = 0; // counts for encoder
volatile long rnant = 0;
// encoders aux variables
volatile byte rant  = 0; // previous encoder state
volatile byte ract  = 0; // actual encoder state
// PID
float rAngVel;
unsigned int rpwm = 0;
float rsetpoint = 0.0; // velocity reference
float re[3] = {0.0,0.0,0.0}; // e[0] actual error, e[1] last error, e[2] error before last
float ru[2] = {0.0,0.0}; // u[0] actual output, u[1] last output


float getAngVel(volatile long n, volatile long nant, double dt){
  float vel = (n - nant) / dt; // Counts per second
  vel = vel/R; // Revolutions per second
  vel = vel * (2.0 * pi); // Radians per second
  return vel;
}

/**
 * @brief PID controller for motor velocity control.
 * 
 * This function implements a discrete-time PID controller using 
 * a difference equation. It updates the control signal based on 
 * the current error and sends PWM signals to control motor direction.
 *
 * @param setpoint Desired angular velocity in rad/s.
 * @param angVel   Measured angular velocity in rad/s.
 * @param e        Error array: e[0] is current error, e[1] and e[2] are past errors.
 * @param u        Control signal array: u[0] is current output, u[1] is previous.
 * @param pwm_chnl1 PWM channel for motor forward direction.
 * @param pwm_chnl2 PWM channel for motor reverse direction.
 * @return float The current control output (u[0]).
 */
float pid(float setpoint, float angVel, float* e, float* u, int pwm_chnl1, int pwm_chnl2){
  // Calculate error
  e[0] = setpoint - angVel;
  u[0] = K1*e[0]+K2*e[1]+K3*e[2]+u[1]; // discrete-time PID difference equation
  // Limit control signal
  if(u[0]>255) u[0] = 255;
  if(u[0]<-255) u[0] = -255;
  // Send control signal to motors
  if(u[0]>=0){
    ledcWrite(pwm_chnl1, u[0]); //
    ledcWrite(pwm_chnl2, 0); // set to 0
  } else{
    ledcWrite(pwm_chnl2, -u[0]); //
    ledcWrite(pwm_chnl1, 0); // set to 0
  }
  // Shift values
  e[2]=e[1];
  e[1]=e[0];
  u[1]=u[0];

  return u[0];
} 

void lencoder(void){
  lant=lact;
  
  if(digitalRead(lA)) bitSet(lact,1); else bitClear(lact,1);            
  if(digitalRead(lB)) bitSet(lact,0); else bitClear(lact,0);
  
  
  
  if(lant == 2 && lact ==0) ln++;
  if(lant == 0 && lact ==1) ln++;
  if(lant == 3 && lact ==2) ln++;
  if(lant == 1 && lact ==3) ln++;
  
  if(lant == 1 && lact ==0) ln--;
  if(lant == 3 && lact ==1) ln--;
  if(lant == 0 && lact ==2) ln--;
  if(lant == 2 && lact ==3) ln--;   

}

void rencoder(void){
  rant=ract;
  
  if(digitalRead(rA)) bitSet(ract,1); else bitClear(ract,1);            
  if(digitalRead(rB)) bitSet(ract,0); else bitClear(ract,0);
  
  
  
  if(rant == 2 && ract ==0) rn++;
  if(rant == 0 && ract ==1) rn++;
  if(rant == 3 && ract ==2) rn++;
  if(rant == 1 && ract ==3) rn++;

  if(rant == 1 && ract ==0) rn--;
  if(rant == 3 && ract ==1) rn--;
  if(rant == 0 && ract ==2) rn--;
  if(rant == 2 && ract ==3) rn--;   

}

int floatMap(float x, float in_min, float in_max, float out_min, float out_max) {
  return (int)((x - in_min) * (out_max - out_min) / (in_max - in_min) + out_min);
}


void setup() {
  Serial.begin(115200);

  // ### Left motor ###
  // Configure encoders
  pinMode(lA, INPUT);
  pinMode(lB, INPUT);
  attachInterrupt(digitalPinToInterrupt(lA), lencoder, CHANGE);
  attachInterrupt(digitalPinToInterrupt(lB), lencoder, CHANGE);

  // Configure PWM
  // Set pins as output
  pinMode(lPWM_PIN_IN1, OUTPUT); 
  pinMode(lPWM_PIN_IN2, OUTPUT);
  // Configure pwm channel
  ledcSetup(PWM_CHNL0, PWM_FRQ, PWM_RES); 
  ledcSetup(PWM_CHNL1, PWM_FRQ, PWM_RES);
  // Assign pins
  ledcAttachPin(lPWM_PIN_IN1, PWM_CHNL0);
  ledcAttachPin(lPWM_PIN_IN2, PWM_CHNL1);

  // ### Right motor ###
  // Configure encoders
  pinMode(rA, INPUT);
  pinMode(rB, INPUT);
  attachInterrupt(digitalPinToInterrupt(rA), rencoder, CHANGE);
  attachInterrupt(digitalPinToInterrupt(rB), rencoder, CHANGE);

  // Configure PWM
  // Set pins as output
  pinMode(rPWM_PIN_IN1, OUTPUT); 
  pinMode(rPWM_PIN_IN2, OUTPUT);
  // Configure pwm channel
  ledcSetup(PWM_CHNL2, PWM_FRQ, PWM_RES); 
  ledcSetup(PWM_CHNL3, PWM_FRQ, PWM_RES);
  // Assign pins
  ledcAttachPin(rPWM_PIN_IN1, PWM_CHNL2);
  ledcAttachPin(rPWM_PIN_IN2, PWM_CHNL3);

  // Control constants (Incremental form)
  K1 = kp + T*ki + kd/T;
  K2 = -kp - 2.0*kd/T;
  K3 = kd/T;

  Serial.println("Starting server");

  #ifdef USE_INTRANET
  WiFi.begin(LOCAL_SSID, LOCAL_PASS);
  while (WiFi.status() != WL_CONNECTED) {
    delay(500);
    Serial.print(".");
  }
  Serial.print("IP address: "); Serial.println(WiFi.localIP());
  Actual_IP = WiFi.localIP();
  #endif

  #ifndef USE_INTRANET
  WiFi.softAPConfig(PageIP, gateway, subnet);
  delay(100);
  WiFi.softAP(AP_SSID, AP_PASS);
  delay(100);
  Actual_IP = WiFi.softAPIP();
  Serial.print("IP address: "); Serial.println(Actual_IP);
  #endif 

  void printWifiStatus(); 

  server.on("/", SendWebsite);

  server.on("/LINEAR_SPEED_SLIDER", Process_linearSpeed_slider);
  server.on("/ANGULAR_SPEED_SLIDER", Process_angularSpeed_slider);
  server.on("/STOP_BUTTON", Process_stop);
  server.on("/FORWARD_BUTTON", Process_forward);
  server.on("/BACKWARD_BUTTON", Process_backward);
  server.on("/LEFT_BUTTON", Process_left);
  server.on("/RIGHT_BUTTON", Process_right);

  server.begin();

}

void loop() {
  server.handleClient();
  unsigned long currentTime = millis();
  double dt = currentTime-prevTime;
  
  if(dt >= sampleTime){
    dt = dt / 1e3; // Convert to seconds

    lsetpoint = (linear - ((l/2.0)*angular))/r;
    rsetpoint = (linear + ((l/2.0)*angular))/r;

    // Estimate Velocity
    lAngVel = getAngVel(ln, lnant, dt);
    rAngVel = getAngVel(rn, rnant, dt);

    // Send Angular velocities through serial 
    char buffer[120];
    sprintf(buffer, "ang_vel_l: %.4f, ang_vel_r: %.4f", lAngVel, rAngVel);
    Serial.println(buffer);

    // Calculate and send control signal to motors
    pid(lsetpoint, lAngVel, le, lu, PWM_CHNL1, PWM_CHNL0); // Left motor
    pid(rsetpoint, rAngVel, re, ru, PWM_CHNL2, PWM_CHNL3); // Right motor
    
    // Print estimation 
    /*
    Serial.print("Set: "); Serial.println(set);
    Serial.print("PWM: "); Serial.println(pwm);
    Serial.print("Count: "); Serial.println(n);
    Serial.print("Rev/s: "); Serial.println(vel);
    */
    //Serial.println(lAngVel);

    // Update values
    lnant = ln;
    rnant = rn;
    prevTime = currentTime;
  }

  if (Serial.available()>0) {
    String input = Serial.readStringUntil('\n');  // Lee la línea completa hasta nueva línea

    // Variables temporales para analizar
    float lin, ang;

    // Usa sscanf para extraer los valores del formato
    int matched = sscanf(input.c_str(), "linear: %f, angular: %f", &lin, &ang);

    if (matched == 2) { // Asegura que ambos valores se leyeron correctamente
      linear = lin;
      angular = ang;
      // Aquí puedes hacer lo que quieras con linear y angular
      Serial.print("Received - Linear: ");
      Serial.print(linear);
      Serial.print(" | Angular: ");
      Serial.println(angular);
    } else {
      Serial.println("Invalid input format.");
    }
  }

}

void SendWebsite() {
  String html = R"rawliteral(
  <!DOCTYPE html>
  <html>
  <head>
    <title>ESP32 Motor Control</title>
    <style>
      body {
        font-family: Arial, sans-serif;
        text-align: center;
        padding: 20px;
      }
      input[type=range] {
        width: 80%;
      }
      .slider-container {
        margin-bottom: 30px;
      }
      .button-grid {
        display: grid;
        grid-template-columns: 80px 80px 80px;
        grid-template-rows: 80px 80px 80px;
        gap: 10px;
        justify-content: center;
        align-items: center;
        margin: auto;
        width: fit-content;
      }
      button {
        width: 80px;
        height: 80px;
        font-size: 16px;
        font-weight: bold;
        border: none;
        border-radius: 10px;
        background-color: #2196F3;
        color: white;
        cursor: pointer;
      }
      button:hover {
        background-color: #0b7dda;
      }
    </style>
  </head>
  <body>
    <h2>ESP32 Motor Speed Control</h2>

    <div class="slider-container">
      <label for="linearSlider">Linear speed:</label><br>
      <input type="range" min="0.0" max="1.0" value="0.0" step="0.01" id="linearSlider" onchange="updateSlider('LINEAR_SPEED_SLIDER', this.value)">
      <p>Value: <span id="linearValue">0.0</span></p>
    </div>

    <div class="slider-container">
      <label for="angularSlider">Angular speed:</label><br>
      <input type="range" min="0.0" max="3.0" value="0.0" step="0.01" id="angularSlider" onchange="updateSlider('ANGULAR_SPEED_SLIDER', this.value)">
      <p>Value: <span id="angularValue">0.0</span></p>
    </div>

    <div class="button-grid">
      <div></div>
      <button onclick="sendCommand('FORWARD_BUTTON')">FORWARD</button>
      <div></div>

      <button onclick="sendCommand('LEFT_BUTTON')">LEFT</button>
      <button onclick="sendCommand('STOP_BUTTON')">STOP</button>
      <button onclick="sendCommand('RIGHT_BUTTON')">RIGHT</button>

      <div></div>
      <button onclick="sendCommand('BACKWARD_BUTTON')">BACKWARD</button>
      <div></div>
    </div>

    <script>
      function updateSlider(type, val) {
        document.getElementById(type.includes('LINEAR') ? 'linearValue' : 'angularValue').innerText = val;
        fetch(`/${type}?VALUE=${val}`)
          .then(response => {
            if (!response.ok) {
              console.error("Error sending slider value");
            }
          });
      }

      function sendCommand(cmd) {
        fetch(`/${cmd}`)
          .then(response => {
            if (!response.ok) {
              console.error("Error sending command");
            }
          });
      }
    </script>
  </body>
  </html>
  )rawliteral";

  server.send(200, "text/html", html);
}


void printWifiStatus() {

  // print the SSID of the network you're attached to:
  Serial.print("SSID: ");
  Serial.println(WiFi.SSID());

  // print your WiFi shield's IP address:
  ip = WiFi.localIP();
  Serial.print("IP Address: ");
  Serial.println(ip);

  // print the received signal strength:
  long rssi = WiFi.RSSI();
  Serial.print("signal strength (RSSI):");
  Serial.print(rssi);
  Serial.println(" dBm");
  // print where to go in a browser:
  Serial.print("Open http://");
  Serial.println(ip);
}
/*
  server.on("/LINEAR_SPEED_SLIDER", Process_linearSpeed_slider);
  server.on("/ANGULAR_SPEED_SLIDER", Process_angularSpeed_slider);
  server.on("/STOP_BUTTON", Process_stop);
  server.on("/FORWARD_BUTTON", Process_forward);
  server.on("/BACKWARD_BUTTON", Process_backward);
  server.on("/LEFT_BUTTON", Process_left);
  server.on("/RIGHT_BUTTON", Process_right);
  */

void Process_linearSpeed_slider(){
  String speed = server.arg("VALUE");

  // conver the string sent from the web page to an int
  linearSpeed = speed.toFloat();
  Serial.print("Update linear speed: "); Serial.println(linearSpeed);
  server.send(200, "text/plain", ""); //Send empty response to web page to keep it alive
}

void Process_angularSpeed_slider(){
  String speed = server.arg("VALUE");

  // conver the string sent from the web page to an int
  angularSpeed = speed.toFloat();
  Serial.print("Update angular speed: "); Serial.println(angularSpeed);
  server.send(200, "text/plain", ""); //Send empty response to web page to keep it alive
}

void Process_stop(){
  linear = 0.0;
  angular = 0.0;
  Serial.println("STOP");
  server.send(200, "text/plain", ""); //Send empty response to web page to keep it alive
}

void Process_forward(){
  linear = linearSpeed;
  angular = 0.0;
  Serial.println("FORWARD");
  server.send(200, "text/plain", ""); //Send empty response to web page to keep it alive
}

void Process_backward(){
  linear = -linearSpeed;
  angular = 0.0;
  Serial.println("BACKWARD");
  server.send(200, "text/plain", ""); //Send empty response to web page to keep it alive
}

void Process_left(){
  linear = 0.0;
  angular = angularSpeed;
  Serial.println("LEFT");
  server.send(200, "text/plain", ""); //Send empty response to web page to keep it alive
}

void Process_right(){
  linear = 0.0;
  angular = -angularSpeed;
  Serial.println("RIGTH");
  server.send(200, "text/plain", ""); //Send empty response to web page to keep it alive
}